const int but1 = 31;
const int but2 = PUSH2;   // or pin 17
const int green  = 39;
const int blue = 40;
const int red = 30;
int lbut1 = 0;
int lbut2 = 0;
int lbut1state = 0; //Button 1 state
int x = 10;
int byte0 = 0;
int byte1 = 0;
int byte2 = 0;
int byte3 = 0;
 
void setup() {
  Serial.begin(9600); 
  pinMode(but1, INPUT_PULLUP);
  pinMode(but2, INPUT_PULLUP);
  pinMode(red, OUTPUT);
  pinMode(blue, OUTPUT);
  pinMode(green, OUTPUT);
}

int cm = 0; 
int pm = 0;
int inter = 100; //data rate in ms
int greenie=0;
int b;
int ab; //column counter

//Simulation data


const float RPM[] = {864,4,2,0.1,0, 98.499466,98.528732,98.610039,98.591064,98.487541,98.477783,98.509224,98.564507,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98.510849,98.512558};
const float LatAcc[] = {0,0,0,0,0, -0.96864,-0.256445,-0.004274,-0.234384,-0.416131,-0.085968,0.316087,0.350908,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-0.340827,-0.264619};
const float ThrotPos[] = {864,0,2,1,0, 11658.121094,12005.581055,12295.1875,12383.853516,12208.767578,11952.007813,11859.273438,11987.017578,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12284.209961,12326.836914};
int ie =  sizeof(RPM); 
int i = 5;

void loop() {
  if(digitalRead(but1) == LOW && lbut2 != 1){
//    Serial.print("Starting Data Point:  ");  
//    Serial.print(i);
      while(digitalRead(but2)!=LOW){
      cm = millis();
      if(cm-pm>inter){
        pm = cm;
        if(i < ie){
          printie();
        }
      }
    }   
    b=1;
  }
  else if(b != 0){
//    Serial.println("\n\n\tStopped....\n\tWaiting for input to send data...\n");
//    Serial.print("Ending Data Point:  ");  
//    Serial.print(i);
//    Serial.print("\n\n");
    b = 0;
  }
  else{
    analogWrite(red,0);
    cm = millis();
    if(cm-pm>500){
      pm = cm;
      if(greenie == 0){
        analogWrite(green, 10);
        greenie = 1;
//        Serial.println("greenie: on");
        }
      else{
        analogWrite(green, 0);
        greenie = 0;
//        Serial.println("greenie: off");
//          delay(500);
        }     
    }
  }
}

void printie(){
    analogWrite(red, x);
//    ab += 1
//    float b0 = RPM[i]
//    float b1 = LatAcc[i]
//    float b2 = ThrotPos[i]
//    Serial.print(",");

    Serial.print("\n");
    Serial.print(RPM[i]);
    Serial.print(",");
    Serial.print(LatAcc[i]);
    Serial.print(",");
    Serial.print(ThrotPos[i]);
     

//    Serial.print(",");
//    Serial.print(byte3, BIN);
    lbut1state = 0;
    i = i + 1;
//    return i; 
}
